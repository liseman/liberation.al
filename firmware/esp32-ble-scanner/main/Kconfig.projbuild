## firmware/esp32-ble-scanner/main/Kconfig.projbuild
```kconfig
menu "Receive-only BLE sensor"
    config BLE_SCANNER_NAME
        string "Initial sensor name (empty uses chip ID, at most 32 UTF-8 bytes)"
        default ""
    config BLE_SCANNER_REPORTS_PER_SECOND
        int "Maximum advertisement lines per second (UART at most 64)"
        range 1 64 if !BLE_SCANNER_USB_SERIAL_JTAG
        range 1 256
        default 32 if !BLE_SCANNER_USB_SERIAL_JTAG
        default 128
    config BLE_SCANNER_QUEUE_SIZE
        int "Fixed advertisement queue capacity"
        range 8 256
        default 64
    config BLE_SCANNER_USB_SERIAL_JTAG
        bool "Use native USB Serial/JTAG instead of UART0"
        depends on SOC_USB_SERIAL_JTAG_SUPPORTED
        default y
    config BLE_SCANNER_UART_BAUD
        int "UART0 baud (ignored by native USB)"
        range 115200 921600
        default 115200
endmenu
```

## firmware/esp32-ble-scanner/sdkconfig.defaults
```kconfig
CONFIG_BT_ENABLED=y
CONFIG_BT_BLUEDROID_ENABLED=n
CONFIG_BT_NIMBLE_ENABLED=y
CONFIG_BT_NIMBLE_LOG_LEVEL_NONE=y
CONFIG_BT_NIMBLE_ROLE_CENTRAL=n
CONFIG_BT_NIMBLE_ROLE_PERIPHERAL=n
CONFIG_BT_NIMBLE_ROLE_BROADCASTER=n
CONFIG_BT_NIMBLE_ROLE_OBSERVER=y
CONFIG_BT_NIMBLE_GAP_SERVICE=n
CONFIG_BT_NIMBLE_SM_LEGACY=n
CONFIG_BT_NIMBLE_SM_SC=n
CONFIG_BT_NIMBLE_EXT_ADV=n
CONFIG_LOG_DEFAULT_LEVEL_NONE=y
CONFIG_LOG_MAXIMUM_LEVEL=0
CONFIG_BOOTLOADER_LOG_LEVEL_NONE=y
CONFIG_ESP_CONSOLE_NONE=y
CONFIG_ESP_SYSTEM_PANIC_SILENT_REBOOT=y
CONFIG_COMPILER_OPTIMIZATION_SIZE=y
CONFIG_PARTITION_TABLE_SINGLE_APP=y
CONFIG_BLE_SCANNER_NAME=""
CONFIG_BLE_SCANNER_REPORTS_PER_SECOND=128
CONFIG_BLE_SCANNER_QUEUE_SIZE=64
CONFIG_BLE_SCANNER_UART_BAUD=115200
CONFIG_APP_REPRODUCIBLE_BUILD=y
```
